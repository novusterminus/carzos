/*
 * Default linker script for Cortex-M (it includes specifics for STM32F[34]xx).
 * 
 */

__carzos_stack_end = ORIGIN(RAM) + LENGTH(RAM);

_estack = __carzos_stack_end; 	/* STM specific definition */

/*
 * Default stack sizes.
 * These are used by the startup in order to allocate stacks 
 * for the different modes.
 */

__carzos_main_stack_size = 1024;

PROVIDE ( _carzos_main_stack_size = __carzos_main_stack_size );

__carzos_main_stack_limit = __carzos_stack_end  - __carzos_main_stack_size;

/* "PROVIDE" allows to easily override these values from an 
 * object file or the command line. */
PROVIDE ( _carzos_main_stack_limit = __carzos_main_stack_limit );

/*
 * Default heap definitions.
 * The heap start immediately after the last statically allocated 
 * .sbss/.noinit section, and extends up to the main stack limit.
 */
PROVIDE ( _carzos_heap_begin = _ebss );
PROVIDE ( _carzos_heap_limit = __carzos_stack_end - __carzos_main_stack_size );

/* 
 * The entry point is informative, for debuggers and simulators,
 * since the Cortex-M vector points to it anyway.
 */
ENTRY(_start)


/* Sections Definitions */

SECTIONS
{
    /*
     * For Cortex-M devices, the beginning of the startup code is stored in
     * the .isr_vector section, which goes to FLASH. 
     */
    .isr_vector : ALIGN(4)
    {
        FILL(0xFF)
        
        __vectors_start = ABSOLUTE(.) ;
        KEEP(*(.isr_vector))     	/* Interrupt vectors */
		     
        /* 
         * This section is here for convenience, to store the
         * startup code at the beginning of the flash area, hoping that
         * this will increase the readability of the listing.
         */
        *(.after_vectors .after_vectors.*)	/* Startup code and ISR */

    } >FLASH

    /*
     * The program code is stored in the .text section, 
     * which goes to FLASH.
     */
    .text : ALIGN(4)
    {
        *(.text .text.*)			/* all remaining code */
 
        /* read-only data (constants) */
        *(.rodata .rodata.* .constdata .constdata.*) 		

		/*
		 * Stub sections generated by the linker, to glue together 
		 * ARM and Thumb code. .glue_7 is used for ARM code calling 
		 * Thumb code, and .glue_7t is used for Thumb code calling 
		 * ARM code. Apparently always generated by the linker, for some
		 * architectures, so better leave them here.
		 */
        *(.glue_7)
        *(.glue_7t)

    } >FLASH

    /* 
     * This address is used by the startup code to 
     * initialise the .data section.
     */
    _data_begin_rom = LOADADDR(.data);

    /*
     * The initialised data section.
     *
     * The program executes knowing that the data is in the RAM
     * but the loader puts the initial values in the FLASH (inidata).
     * It is one task of the startup to copy the initial values from 
     * FLASH to RAM.
     */
    .data : ALIGN(4)
    {
    	FILL(0xFF)
        /* This is used by the startup code to initialise the .data section */
        _data_begin_ram = . ;
        *(.data_begin .data_begin.*)

        *(.data .data.*)
		
        *(.data_end .data_end.*)
        . = ALIGN(4);

        /* This is used by the startup code to initialise the .data section */
        _data_end_ram = . ;

    } >RAM AT>FLASH
    
    /*
     * The uninitialised data sections. NOLOAD is used to avoid
     * the "section `.bss' type changed to PROGBITS" warning
     */

    /* The primary uninitialised data section. */
    .bss (NOLOAD) : ALIGN(4)
    {
        _bss_begin_ram = .;
        *(.bss_begin .bss_begin.*)

        *(.bss .bss.*)
        *(COMMON)
        
        *(.bss_end .bss_end.*)
	    . = ALIGN(4);
        _bss_end_ram = . ;
    } >RAM

    /*
     * Used for validation only, do not allocate anything here!
     *
     * This is just to check that there is enough RAM left for the Main
     * stack. It should generate a link error if it's full.
	 */
    ._check_stack : ALIGN(4)
    {
        . = . + __carzos_main_stack_size;
    } >RAM

    /DISCARD/ :
    {
        * ( .shstrtab* )
    }
}
